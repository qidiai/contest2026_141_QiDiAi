## board/contest_board/Kconfig
```kconfig
if ARCH_BOARD_CONTEST2026_141_BOARD

config ARCH_BOARD_CONTEST2026_141_BOARD_TAG
	string "Board tag"
	default "contest2026_141_board"

endif # ARCH_BOARD_CONTEST2026_141_BOARD
```
